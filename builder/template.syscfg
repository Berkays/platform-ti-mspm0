/**
 * These arguments were used when this file was generated. They will be automatically applied on subsequent loads
 * via the GUI or CLI. Run CLI with '--help' for additional information on how to override these arguments.
 * @cliArgs --device "MSPM0L110X" --part "Default" --package "VQFN-32(RHB)" --product "mspm0_sdk@2.08.00.03"
 * @v2CliArgs --device "MSPM0L1106" --package "VQFN-32(RHB)" --product "mspm0_sdk@2.08.00.03"
 * @versions {"tool":"1.24.1+4189"}
 */

const ProjectConfig = scripting.addModule("/ti/project_config/ProjectConfig");

ProjectConfig.deviceSpin = "MSPM0L1106";
